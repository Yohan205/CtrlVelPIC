#include "ssd1306_oled.h"
#include "mcc_generated_files/system/system.h"

// Cambiar alcance de las fuentes a "const" (coincidir con extern en el .h)
const uint8_t FONT_1[] = {
    0x06, 0x08, 0x20, 0x5F,             // x_size, y_size, offset, number of char
    0x00, 0x00, 0x00, 0x00, 0x00, 0x00, // sp
    0x00, 0x00, 0x00, 0x2f, 0x00, 0x00, // !
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    0x14, 0x14, 0x14, 0x14, 0x14, 0x14, // horiz lines // DEL
    0x00                                /* This byte is required for italic type of font */
};

const uint8_t FONT_2[] = {
    0x08,
    0x10,
    0x20,
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    0x00, // ~ 94
};

/* Dibuja un bitmap almacenado por columnas.
   bitmap: datos columna por columna; cada columna consume (h+7)/8 bytes;
   bit 0 de cada byte corresponde a la fila superior de ese bloque de 8 pixels. */
void OLED_DrawBitmap(int16_t x, int16_t y, const uint8_t *bitmap, uint8_t w, uint8_t h, uint8_t color)
{
    if (bitmap == NULL)
        return;
    uint8_t bytesPerCol = (h + 7) / 8;
    for (uint8_t col = 0; col < w; col++)
    {
        for (uint8_t byteRow = 0; byteRow < bytesPerCol; byteRow++)
        {
            uint8_t b = *(bitmap + col * bytesPerCol + byteRow);
            for (uint8_t bit = 0; bit < 8; bit++)
            {
                uint8_t row = byteRow * 8 + bit;
                if (row >= h)
                    break; // fuera de alto solicitado
                int16_t px = x + col;
                int16_t py = y + row;
                if (b & (1 << bit))
                {
                    OLED_DrawPixel(px, py, color == INVERSE ? INVERSE : WHITE);
                }
                else
                {
                    if (color == INVERSE)
                        OLED_DrawPixel(px, py, WHITE);
                    else if (color == BLACK)
                        OLED_DrawPixel(px, py, BLACK);
                    else
                        ; // si color==WHITE y bit==0, dejamos como esta (no setear)
                }
            }
        }
    }
}

static Current_Font_s cfont;
static uint8_t buffer[SSD1306_LCDHEIGHT * SSD1306_LCDWIDTH / 8] = {
    0x00, 0x00, 0x00, 0x00, 0x00, 0x00, 0x00, 0x00, 0x00, 0x00, 0x00, 0x00, 0x00, 0x00, 0x00, 0x00,
    0x00, 0x00, 0x00, 0x00, 0x00, 0x00, 0x00, 0x00, 0x00, 0x00, 0x00, 0x00, 0x00, 0x00, 0x00, 0x00,
    0x00, 0x00, 0x00, 0x00, 0x00, 0x00, 0x00, 0x00, 0x00, 0x00, 0x00, 0x00, 0x00, 0x00, 0x00, 0x00,
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    0xC0, 0xC0, 0x80, 0x00, 0x00, 0x00, 0x00, 0x80, 0x80, 0xC0, 0xC0, 0xC0, 0xC0, 0xC0, 0x80, 0x00,
#if (SSD1306_LCDHEIGHT * SSD1306_LCDWIDTH > 96 * 16)
    0x00, 0x00, 0x00, 0x80, 0x80, 0xC0, 0xC0, 0xC0, 0xC0, 0x80, 0xFE, 0xFE, 0xFE, 0x00, 0x00, 0x00,
    0x80, 0x80, 0xC0, 0xC0, 0xC0, 0xC0, 0x80, 0xFE, 0xFE, 0xFE, 0x00, 0x00, 0x00, 0x80, 0x80, 0xC0,
    0xC0, 0xC0, 0xC0, 0xC0, 0x80, 0x00, 0x00, 0x00, 0x00, 0x80, 0x80, 0xC0, 0xC0, 0xC0, 0xC0, 0x80,
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    0x00, 0x00, 0x00, 0x00, 0x00, 0x00, 0x00, 0x00, 0x00, 0x00, 0x00, 0x00, 0x00, 0x00, 0x00, 0x00
#endif

};

static bool i2c_write(uint16_t address, uint8_t *data, size_t len)
{
    uint32_t timeout = 1000; // timeout en ms
    /* iniciar la transferencia */
    if (!I2C1_Write(address, data, len))
    {
        return false;
    }
    /* Esperar a que la transferencia termine o agote el timeout */
    while (I2C1_IsBusy() && timeout)
    {
        __delay_ms(1);
        timeout--;
    }
    if (timeout == 0)
        return false;
    /* Comprobar si hubo error en el bus */
    if (I2C1_ErrorGet() != I2C_ERROR_NONE)
        return false;
    return true;
}

static inline void ssd1306_command(uint8_t command)
{
    uint8_t data[2] = {0x00, 0x00}; // Control byte para comando
    data[1] = command;
    (void)i2c_write(SSD1306_ADDR, data, 2);
}

static inline void ssd1306_data(uint8_t value)
{
    uint8_t data[2] = {0x40, 0x00}; // Control byte para datos
    data[1] = value;
    (void)i2c_write(SSD1306_ADDR, data, 2);
}

void OLED_Init(void)
{
    __delay_ms(100);
    ssd1306_command(SSD1306_DISPLAY_OFF);
    ssd1306_command(SSD1306_SET_DISPLAY_CLOCK_DIV_RATIO);
    ssd1306_command(0x80);
    ssd1306_command(SSD1306_SET_MULTIPLEX_RATIO);
    ssd1306_command(SSD1306_LCDHEIGHT - 1);
    ssd1306_command(SSD1306_SET_DISPLAY_OFFSET);
    ssd1306_command(0x00);
    ssd1306_command(SSD1306_SET_START_LINE | 0x00); // Line: 0
    ssd1306_command(SSD1306_CHARGE_PUMP);
    // ssd1306_command(0x10); This will be used with External VCC
    ssd1306_command(0x14);
    ssd1306_command(SSD1306_MEMORY_ADDR_MODE);
    ssd1306_command(0x00); // Horizontal Addressing Mode is Used
    ssd1306_command(SSD1306_SET_SEGMENT_REMAP | 0x01);
    ssd1306_command(SSD1306_COM_SCAN_DIR_DEC);

#if defined SSD1306_128_32
    ssd1306_command(SSD1306_SET_COM_PINS);
    ssd1306_command(0x02);
    ssd1306_command(SSD1306_SET_CONTRAST_CONTROL);
    ssd1306_command(0x8F);

#elif defined SSD1306_128_64
    ssd1306_command(SSD1306_SET_COM_PINS);
    ssd1306_command(0x12);
    ssd1306_command(SSD1306_SET_CONTRAST_CONTROL);
    // ssd1306_command(0x9F);  Use with External VCC
    ssd1306_command(0xCF);
#endif
    ssd1306_command(SSD1306_SET_PRECHARGE_PERIOD);
    // ssd1306_command(0x22); Use with External VCC
    ssd1306_command(0xF1);
    ssd1306_command(SSD1306_SET_VCOM_DESELECT);
    ssd1306_command(0x40);
    ssd1306_command(SSD1306_DISPLAY_ALL_ON_RESUME);
    ssd1306_command(SSD1306_NORMAL_DISPLAY);
    ssd1306_command(SSD1306_DEACTIVATE_SCROLL);
    ssd1306_command(SSD1306_DISPLAY_ON);
    OLED_ClearDisplay();
    OLED_Update();
}

uint8_t OLED_Width(void)
{
    return SSD1306_LCDWIDTH;
}

uint8_t OLED_Height(void)
{
    return SSD1306_LCDHEIGHT;
}

void OLED_SetFont(const uint8_t *font)
{
    cfont.font = font;
    cfont.x_size = *(font + 0);
    cfont.y_size = *(font + 1);
    cfont.offset = *(font + 2);
    cfont.numchars = *(font + 3);
    cfont.inverted = false;
}

void OLED_InvertFont(uint8_t invert_status)
{
    if (invert_status)
    {
        cfont.inverted = true;
    }
    else
    {
        cfont.inverted = false;
    }
}

void OLED_Update(void)
{
    uint16_t i = 0;
    uint8_t x = 0;
    ssd1306_command(SSD1306_SET_COLUMN_ADDR);
    ssd1306_command(0);
    ssd1306_command(SSD1306_LCDWIDTH - 1);
    ssd1306_command(SSD1306_SET_PAGE_ADDR);
    ssd1306_command(0);
#if SSD1306_LCDHEIGHT == 64
    ssd1306_command(7);
#endif
#if SSD1306_LCDHEIGHT == 32
    ssd1306_command(3);
#endif
#if SSD1306_LCDHEIGHT == 16
    ssd1306_command(1);
#endif
    /* Reusar un buffer temporal para evitar crear arrays en cada iteración */
    uint8_t data[17];
    data[0] = 0x40; // Control byte para datos
    const size_t total = (SSD1306_LCDWIDTH * SSD1306_LCDHEIGHT) / 8;
    size_t sent = 0;
    while (sent < total)
    {
        /* enviar hasta 16 bytes por transacción (data[0] es el control) */
        size_t remaining = total - sent;
        uint8_t chunk = (uint8_t)((remaining > 16) ? 16U : remaining);
        for (x = 0; x < chunk; x++)
        {
            data[1 + x] = buffer[sent + x];
        }
        /* Llamada al wrapper i2c_write */
        (void)i2c_write(SSD1306_ADDR, data, 1 + chunk);
        sent += chunk;
    }
}

void OLED_SetContrast(uint8_t contrast)
{
    ssd1306_command(SSD1306_SET_CONTRAST_CONTROL);
    ssd1306_command(contrast);
}

void OLED_ClearDisplay(void)
{
    memset(buffer, 0, (SSD1306_LCDWIDTH * SSD1306_LCDHEIGHT / 8));
}

void OLED_FillDisplay(void)
{
    memset(buffer, 0xFF, (SSD1306_LCDWIDTH * SSD1306_LCDHEIGHT / 8));
}

void OLED_InvertDisplay(uint8_t value)
{
    if (value)
    {
        ssd1306_command(SSD1306_INVERT_DISPLAY);
    }
    else
    {
        ssd1306_command(SSD1306_NORMAL_DISPLAY);
    }
}

void OLED_DrawPixel(int16_t x, int16_t y, uint8_t color)
{
    if ((x < 0) || (x >= SSD1306_LCDWIDTH) || (y < 0) || (y >= SSD1306_LCDHEIGHT))
        return;

    uint16_t page = (uint16_t)(y >> 3); /* y / 8 */
    uint16_t index = (uint16_t)(x + page * SSD1306_LCDWIDTH);
    uint8_t mask = (uint8_t)(1U << (y & 7));

    if (color == WHITE)
    {
        buffer[index] |= mask;
    }
    else if (color == BLACK)
    {
        buffer[index] &= (uint8_t)~mask;
    }
    else /* INVERSE */
    {
        buffer[index] ^= mask;
    }
}

void OLED_Write(int16_t x, int16_t y, char value)
{
    uint16_t font_idx = 0;
    uint16_t rowcnt = 0;
    uint16_t cnt = 0;
    uint8_t b;
    uint16_t temp = 0;
    int16_t cbyte, cx, cy;
    int16_t cbit;

    if (cfont.y_size % 8 == 0)
    {
        font_idx = ((value - cfont.offset) * (cfont.x_size * (cfont.y_size / 8))) + 4;
        /* Si el Y está alineado a página (múltiplo de 8), podemos escribir
           columnas completas directamente en el buffer en lugar de pixel a pixel. */
        if ((y & 7) == 0)
        {
            uint16_t pages = (uint16_t)(cfont.y_size / 8);
            for (cnt = 0; cnt < cfont.x_size; cnt++)
            {
                for (rowcnt = 0; rowcnt < pages; rowcnt++)
                {
                    temp = *(cfont.font + font_idx + cnt + (rowcnt * cfont.x_size));
                    uint16_t page = (uint16_t)((y >> 3) + rowcnt);
                    uint16_t index = (uint16_t)(x + cnt + page * SSD1306_LCDWIDTH);
                    if (cfont.inverted)
                    {
                        buffer[index] = (uint8_t)~temp;
                    }
                    else
                    {
                        buffer[index] = (uint8_t)temp;
                    }
                }
            }
        }
        else
        {
            /* Fallback: no alineado a pagina, mantener comportamiento por píxel */
            for (rowcnt = 0; rowcnt < (cfont.y_size / 8); rowcnt++)
            {
                for (cnt = 0; cnt < cfont.x_size; cnt++)
                {
                    temp = *(cfont.font + font_idx + cnt + (rowcnt * cfont.x_size));
                    for (b = 0; b < 8; b++)
                    {
                        int16_t px = (int16_t)x + (int16_t)cnt;
                        int16_t py = (int16_t)y + (int16_t)(rowcnt * 8) + (int16_t)b;
                        if (temp & (1 << b))
                        {
                            if (cfont.inverted == false)
                                OLED_DrawPixel(px, py, true);
                            else
                                OLED_DrawPixel(px, py, false);
                        }
                        else
                        {
                            if (cfont.inverted == false)
                                OLED_DrawPixel(px, py, false);
                            else
                                OLED_DrawPixel(px, py, true);
                        }
                    }
                }
            }
        }
    }
    else
    {
        font_idx = ((value - cfont.offset) * ((cfont.x_size * cfont.y_size) / 8)) + 4;
        cbyte = *(cfont.font + font_idx);
        cbit = 7;
        for (cx = 0; cx < cfont.x_size; cx++)
        {
            for (cy = 0; cy < cfont.y_size; cy++)
            {
                if ((cbyte & (1 << cbit)) != 0)
                {
                    if (cfont.inverted == false)
                        OLED_DrawPixel(x + cx, y + cy, true);
                    else
                        OLED_DrawPixel(x + cx, y + cy, false);
                }
                else
                {
                    if (cfont.inverted == false)
                        OLED_DrawPixel(x + cx, y + cy, false);
                    else
                        OLED_DrawPixel(x + cx, y + cy, true);
                }
                cbit--;
                if (cbit < 0)
                {
                    cbit = 7;
                    font_idx++;
                    cbyte = *(cfont.font + font_idx);
                }
            }
        }
    }
}

void OLED_Write_Text(int16_t x, int16_t y, char *text)
{
    size_t cnt;
    size_t length;
    length = strlen((const char *)text);
    if (x == RIGHT)
        x = SSD1306_LCDWIDTH - (int16_t)(length * cfont.x_size);
    if (x == CENTER)
        x = (SSD1306_LCDWIDTH - (int16_t)(length * cfont.x_size)) / 2;
    for (cnt = 0; cnt < length; cnt++)
        OLED_Write(x + (int16_t)(cnt * (cfont.x_size)), y, *text++);
}